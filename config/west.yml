## config/west.yml
```yaml
manifest:
  remotes:
    - name: zmkfirmware
      url-base: https://github.com/zmkfirmware
    - name: PolarityWorks
      url-base: https://github.com/PolarityWorks
  projects:
    - name: zmk
      remote: PolarityWorks
      revision: zephyr-3.5
      import: app/west.yml
  self:
    path: config
```
